# CY8C4245AXI_483 register map
File version: 0.1
PSoC 4200
Registers are 32-bit, read-write, no defined reset value unless marked. A register's access mark holds for its fields unless they carry their own. Offsets are from the block's base; lines under a group give offsets from that group; [hi:lo] are bit positions; {n}, {i} and the like mark numbered series; 'fields as' and 'values as' point back to an identical list; <NAME> marks a mode.

## Memory map
0x40050108 LED_CONTROL size 0x11
0x40080004 CapSense_CSD_IDAC1 size 0xFF01 — IDAC
0x40080004 CapSense_CSD_IDAC2 size 0xFF01 — IDAC

## CapSense_CSD_IDAC1 — IDAC
Base 0x40080004
Same registers: CapSense_CSD_IDAC2 0x40080004
0x00 CSD_IDAC_POLARITY
0x04 CSD_IDAC
0xFEFC CSD_TRIM1 — CSD IDAC TRIM1
0xFF00 CSD_TRIM2 — CSD IDAC TRIM2

## LED_CONTROL
Base 0x40050108
0x00 COUNTER — Current counter value
0x04 CC — Compare / capture value
0x08 CC_BUF — Compare / capture buffer value
0x0C PERIOD — Period value
0x10 PERIOD_BUF — Period buffer value
